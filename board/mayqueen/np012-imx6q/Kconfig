## board/mayqueen/np012-imx6q/Kconfig
```kconfig
if TARGET_MX6NP012

config SYS_BOARD
	default "np012-imx6q"

config SYS_VENDOR
	default "mayqueen"

config SYS_SOC
	default "mx6"

config SYS_CONFIG_NAME
	default "np012-imx6q"

endif
```

## board/tailyn/bf8a1/Kconfig
```kconfig
if TARGET_BF8A1

config SYS_BOARD
	default "bf8a1"

config SYS_VENDOR
	default "tailyn"

config SYS_SOC
	default "mx6"

config SYS_CONFIG_NAME
	default "bf8a1"

endif
```

## configs/mx6_bf8a1_defconfig
```kconfig
CONFIG_SYS_EXTRA_OPTIONS="IMX_CONFIG=board/tailyn/bf8a1/mx6q_4x_mt41j128.cfg,MX6Q"
CONFIG_ARM=y
CONFIG_TARGET_BF8A1=y
CONFIG_DM=y
CONFIG_DM_THERMAL=y
```

## configs/mx6qnp012_defconfig
```kconfig
CONFIG_SYS_EXTRA_OPTIONS="IMX_CONFIG=board/mayqueen/np012-imx6q/np012-imx6q.cfg"
CONFIG_ARM=y
CONFIG_TARGET_MX6NP012=y
CONFIG_SYS_MALLOC_F=y
CONFIG_SYS_MALLOC_F_LEN=0x400
CONFIG_DM=y
CONFIG_DM_THERMAL=y
```

## configs/nuts_almond_defconfig
```kconfig
CONFIG_SPL=y
CONFIG_SPL_STACK_R=y
CONFIG_SPL_STACK_R_ADDR=0x82000000
CONFIG_SYS_EXTRA_OPTIONS="NAND"
CONFIG_CONS_INDEX=4
CONFIG_ARM=y
CONFIG_TARGET_NUTS_ALMOND=y
```
